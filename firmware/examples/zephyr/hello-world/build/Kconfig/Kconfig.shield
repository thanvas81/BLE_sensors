## firmware/examples/zephyr/hello-world/build/Kconfig/Kconfig.shield
```kconfig
osource "C:/Users/Asus/Desktop/Files/School/Thesis/blecon-device-sdk/examples/zephyr/boards/minew/minew_me54be01/boards/shields/*/Kconfig.shield"
osource "C:/test/blinky_pwm/boards/shields/*/Kconfig.shield"
osource "C:/ncs/v2.9.1/nrf/boards/shields/*/Kconfig.shield"
```

## firmware/examples/zephyr/hello-world/build/Kconfig/boards/Kconfig.defconfig
```kconfig
# Load Zephyr board defconfig descriptions.
osource "C:/Users/Asus/Desktop/Files/School/Thesis/blecon-device-sdk/examples/zephyr/boards/minew/minew_me54be01/boards/minew/minew_me54be01/Kconfig.defconfig"
```

## firmware/examples/zephyr/hello-world/build/hello-world/Kconfig/Kconfig.shield.defconfig
```kconfig
osource "C:/Users/Asus/Desktop/Files/School/Thesis/blecon-device-sdk/examples/zephyr/boards/minew/minew_me54be01/boards/shields/*/Kconfig.defconfig"
osource "C:/test/blinky_pwm/boards/shields/*/Kconfig.defconfig"
osource "C:/ncs/v2.9.1/nrf/boards/shields/*/Kconfig.defconfig"
```
